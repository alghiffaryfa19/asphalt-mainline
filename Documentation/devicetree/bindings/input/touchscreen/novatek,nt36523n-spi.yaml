## Documentation/devicetree/bindings/input/touchscreen/novatek,nt36523n-spi.yaml
```yaml
# SPDX-License-Identifier: (GPL-2.0-only OR BSD-2-Clause)
%YAML 1.2
---
$id: http://devicetree.org/schemas/input/touchscreen/novatek,nt36523n-spi.yaml#
$schema: http://devicetree.org/meta-schemas/core.yaml#

title: Novatek NT36523N SPI touchscreen controller

maintainers:
  - dianqk <dianqk@dianqk.net>

allOf:
  - $ref: touchscreen.yaml#
  - $ref: /schemas/spi/spi-peripheral-props.yaml#

properties:
  compatible:
    const: novatek,nt36523n-spi

  reg:
    maxItems: 1

  interrupts:
    maxItems: 1

  reset-gpios:
    maxItems: 1

  firmware-name:
    maxItems: 1

  panel: true

  spi-max-frequency:
    maximum: 9600000

  touchscreen-size-x: true
  touchscreen-size-y: true
  touchscreen-inverted-x: true
  touchscreen-inverted-y: true
  touchscreen-swapped-x-y: true

required:
  - compatible
  - reg
  - interrupts
  - reset-gpios
  - firmware-name
  - panel
  - spi-max-frequency

additionalProperties: false

examples:
  - |
    #include <dt-bindings/gpio/gpio.h>
    #include <dt-bindings/interrupt-controller/irq.h>

    spi {
        #address-cells = <1>;
        #size-cells = <0>;

        touchscreen@0 {
            compatible = "novatek,nt36523n-spi";
            reg = <0>;
            spi-max-frequency = <9600000>;
            interrupts-extended = <&tlmm 21 IRQ_TYPE_EDGE_RISING>;
            reset-gpios = <&tlmm 20 GPIO_ACTIVE_LOW>;
            firmware-name = "novatek/lenovo-tb320fc.bin";
            panel = <&panel>;
            touchscreen-size-x = <1600>;
            touchscreen-size-y = <2560>;
        };
    };
...
```
